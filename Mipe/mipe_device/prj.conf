## CMakeLists.txt
```
# SPDX-License-Identifier: Apache-2.0

cmake_minimum_required(VERSION 3.20.0)

find_package(Zephyr REQUIRED HINTS $ENV{ZEPHYR_BASE})
project(singleping_mipe)

target_include_directories(app PRIVATE include)

target_sources(app PRIVATE
    src/main.c
    src/led_control.c
    src/button_control.c
    src/ble_service.c
    src/connection_manager.c
    src/battery_monitor.c
)
```

## prj.conf
```kconfig
# GPIO configuration
CONFIG_GPIO=y

# Console and logging
CONFIG_STDOUT_CONSOLE=y
CONFIG_PRINTK=y
CONFIG_LOG=y
CONFIG_LOG_DEFAULT_LEVEL=3

# Use newlib instead of picolibc to avoid compatibility issues
CONFIG_NEWLIB_LIBC=y
CONFIG_PICOLIBC=n

# Bluetooth configuration
CONFIG_BT=y
CONFIG_BT_PERIPHERAL=y
CONFIG_BT_DEVICE_NAME="MIPE"

# Bluetooth advertising
CONFIG_BT_DEVICE_APPEARANCE=0
CONFIG_BT_MAX_CONN=1

# Bluetooth stack settings
CONFIG_BT_HCI=y
CONFIG_BT_CTLR=y
CONFIG_BT_BROADCASTER=y
CONFIG_BT_OBSERVER=n

# Set maximum TX power for better RSSI readings (+8 dBm)
CONFIG_BT_CTLR_TX_PWR_PLUS_8=y

# GATT services
CONFIG_BT_GATT_DYNAMIC_DB=y
CONFIG_BT_GATT_SERVICE_CHANGED=y
CONFIG_BT_ATT_PREPARE_COUNT=2

# Device Information Service (optional but useful)
CONFIG_BT_DIS=n

# Connection parameters for power optimization
# 30ms (24 * 1.25ms)
CONFIG_BT_PERIPHERAL_PREF_MIN_INT=24
# 50ms (40 * 1.25ms)
CONFIG_BT_PERIPHERAL_PREF_MAX_INT=40
CONFIG_BT_PERIPHERAL_PREF_LATENCY=4
# 4 seconds (400 * 10ms)
CONFIG_BT_PERIPHERAL_PREF_TIMEOUT=400

# ADC for battery monitoring
CONFIG_ADC=y
CONFIG_ADC_ASYNC=y
CONFIG_ADC_NRFX_SAADC=y
CONFIG_ADC_LOG_LEVEL_DBG=y

# Memory settings for BLE
CONFIG_HEAP_MEM_POOL_SIZE=2048
CONFIG_MAIN_STACK_SIZE=2048
CONFIG_SYSTEM_WORKQUEUE_STACK_SIZE=2048
CONFIG_BT_RX_STACK_SIZE=2048

# Power management (for future TMT6 optimization)
CONFIG_PM=n
CONFIG_PM_DEVICE=n
```

## app.overlay
```dts
/*
 * Device Tree Overlay for Mipe Device
 * Configures ADC for battery voltage monitoring
 */

&adc {
    status = "okay";
    #address-cells = <1>;
    #size-cells = <0>;
    
    channel@0 {
        reg = <0>;
        zephyr,gain = "ADC_GAIN_1_4";
        zephyr,reference = "ADC_REF_INTERNAL";
        zephyr,acquisition-time = <ADC_ACQ_TIME(ADC_ACQ_TIME_MICROSECONDS, 40)>;
        zephyr,input-positive = <2>;  /* AIN2 - P0.04 pin, adjust based on your hardware */
        zephyr,resolution = <12>;
    };
};
```

## src/main.c
```c
/**
 * SinglePing Mipe Device - Power-Optimized BLE Peripheral
 * 
 * SYSTEM ARCHITECTURE:
 * MotoApp (Android) ←→ BLE ←→ Host (NRF54L15DK) ←→ BLE ←→ Mipe Device
 * 
 * MIPE DEVICE ROLE:
 * - Power-optimized BLE peripheral for distance measurement
 * - Minimal power consumption (TARGET: 30+ days battery life)
 * - Host-controlled measurement sessions ONLY
 * - NEVER initiates communication, only responds
 * - Stable signal characteristics for accurate RSSI
 * - Consistent transmission power and timing
 * 
 * POWER-FIRST DESIGN PRINCIPLES:
 * 1. Mipe transmits MINIMALLY - only when prompted and absolutely necessary
 * 2. Every transmission costs battery life - must be justified
 * 3. Sleep mode is the default state
 * 4. Wake only for measurement sessions
 * 5. Single ping response mechanism (no repeated transmissions)
 * 
 * CONNECTION RECOVERY PROTOCOL:
 * - Upon connection loss: Enter "Listening Mode"
 * - Listening Mode: Low-power advertising (1000ms intervals)
 * - Listen for Host reconnection ping
 * - Single response to reconnection ping (no repeats)
 * - Timeout: 5 minutes in listening mode, then deep sleep
 * 
 * CONNECTION STATES:
 * 1. ADVERTISING: Initial pairing mode, high power advertising
 * 2. LISTENING: Post-connection loss, low power advertising
 * 3. CONNECTED: Active connection with Host
 * 4. MEASURING: Responding to measurement session
 * 5. DEEP_SLEEP: Power conservation mode, no advertising
 * 
 * PROTOCOL SPECIFICATIONS:
 * - Packet sizes minimized (2-7 bytes typical)
 * - No acknowledgments unless critical
 * - Immediate sleep after session termination
 * - Fixed RF parameters for measurement consistency
 * 
 * TMT PHASES:
 * - TMT3: Basic Mipe-Host integration
 * - TMT4: Real RSSI measurements
 * - TMT5: RF optimization for accuracy
 * - TMT6: Power optimization for 30+ day battery life
 * 
 * TARGET SPECIFICATIONS:
 * - Distance accuracy: 10%
 * - Battery life: 30+ days
 * - Response time: <100ms
 * - Power consumption in listening mode: <10μA average
 */

#include "led_control.h"
#include "button_control.h"
#include "ble_service.h"
#include "connection_manager.h"
#include "battery_monitor.h"
#include <zephyr/kernel.h>

/**
 * Main entry point for Mipe device - POWER OPTIMIZED
 * Minimal initialization and power-conscious main loop
 */
int main(void) {
    /* POWER OPTIMIZATION: Minimal initialization sequence */
    
    /* Initialize button control for SW3 battery reading
     * SW0 for other functions, SW3 specifically for battery
     */
    button_control_init();
    
    /* Initialize battery monitoring for advertising data
     * Battery voltage will be included in every advertising packet
     */
    battery_monitor_init();
    
    /* Initialize BLE service and start advertising immediately
     * This is the primary function - advertising for RSSI measurement
     */
    ble_service_init();
    
    /* Initialize connection manager for Host communication
     * Handles connection states and recovery protocol
     */
    connection_manager_init();
    
    /* POWER OPTIMIZATION: No LED patterns at startup
     * LEDs consume power - only use when absolutely necessary
     */
    
    printk("========================================\n");
    printk("MIPE DEVICE STARTED\n");
    printk("  BLE advertising: ACTIVE with battery data\n");
    printk("  Battery monitoring: INITIALIZED\n");
    printk("  SW3 button: Manual battery read\n");
    printk("========================================\n");

    /* Main control loop - POWER OPTIMIZED
     * Minimal processing, maximum sleep time
     */
    while (1) {
        /* Check buttons - primary user interface
         * SW3 triggers battery read, SW0 for other functions
         */
        button_control_update();
        
        /* Check if SW3 was pressed for battery reading */
        if (button_sw3_was_pressed()) {
            /* Read battery voltage once and log it */
            battery_monitor_read_once();
        }
        
        /* Process BLE events - essential for operation
         * Handles advertising and Host communication
         */
        ble_service_update();
        
        /* Manage connection states - essential for recovery
         * Handles connection loss and recovery protocol
         */
        connection_manager_update();
        
        /* POWER OPTIMIZATION: Removed unnecessary updates
         * - No LED updates (saves power)
         * - No periodic battery monitoring (only on-demand)
         */

        /* Sleep between updates to conserve power
         * Increased from 10ms to 100ms for better power savings
         * Still responsive enough for button presses and BLE events
         */
        k_msleep(100);
    }

    return 0;
}
```

## include/battery_monitor.h
```c
/**
 * Mipe Device Battery Monitor Header
 * 
 * Battery monitoring interface for power management
 */

#ifndef BATTERY_MONITOR_H
#define BATTERY_MONITOR_H

#include <stdint.h>
#include <stdbool.h>

/**
 * Initialize battery monitoring
 * Sets up ADC for battery voltage measurement
 */
void battery_monitor_init(void);

/**
 * Update battery monitoring
 * Should be called periodically to check battery status
 * NOTE: For power optimization, this is now deprecated - use battery_monitor_read_once() instead
 */
void battery_monitor_update(void);

/**
 * Read battery voltage once (on-demand)
 * Power-optimized function to read battery only when requested (e.g., button press)
 * Updates internal state and logs the reading
 */
void battery_monitor_read_once(void);

/**
 * Get current battery level as percentage
 * @return Battery level 0-100%
 */
uint8_t battery_monitor_get_level(void);

/**
 * Get current battery voltage in millivolts
 * @return Battery voltage in mV
 */
uint16_t battery_monitor_get_voltage_mv(void);

/**
 * Check if battery is low
 * @return true if battery is below low threshold (20%)
 */
bool battery_monitor_is_low(void);

/**
 * Check if battery is critical
 * @return true if battery is critically low (<10%)
 */
bool battery_monitor_is_critical(void);

#endif // BATTERY_MONITOR_H
```

## include/ble_service.h
```c
/**
 * Mipe Device BLE Service Header
 * 
 * Power-optimized BLE Peripheral interface for Host communication
 */

#ifndef BLE_SERVICE_H
#define BLE_SERVICE_H

#include <stdbool.h>

/**
 * Initialize BLE service
 * Sets up Bluetooth stack, GATT services, and starts advertising
 */
void ble_service_init(void);

/**
 * Update BLE service
 * Called from main loop to process BLE events
 */
void ble_service_update(void);

/**
 * Start power-optimized listening mode
 * Enters low-power advertising mode after disconnection
 * for reconnection with minimal battery consumption
 */
void ble_service_start_listening_mode(void);

/**
 * Send battery level notification to Host
 * Only sends when battery level changes significantly
 * @return 0 on success, negative error code on failure
 */
int ble_service_notify_battery(void);

/**
 * Check if connected to Host
 * @return true if connected, false otherwise
 */
bool ble_service_is_connected(void);

#endif // BLE_SERVICE_H
```

## include/button_control.h
```c
#ifndef BUTTON_CONTROL_H
#define BUTTON_CONTROL_H

#include <stdbool.h>

void button_control_init(void);
void button_control_update(void);
bool button_was_pressed(void);
bool button_sw3_was_pressed(void);  /* SW3 for battery read */

#endif // BUTTON_CONTROL_H
```

## include/connection_manager.h
```c
/**
 * Connection Manager Header - P003 Implementation
 * 
 * Provides BLE connection management for Mipe device
 * Handles connection states, recovery, and power optimization
 */

#ifndef CONNECTION_MANAGER_H
#define CONNECTION_MANAGER_H

#include <stdbool.h>
#include <stdint.h>

/**
 * Initialize connection manager
 * Sets up BLE connection handling and state machine
 */
void connection_manager_init(void);

/**
 * Update connection manager
 * Handles state transitions and timeout management
 * Should be called periodically from main loop
 */
void connection_manager_update(void);

/**
 * Check if device is currently connected
 * @return true if connected to Host, false otherwise
 */
bool connection_manager_is_connected(void);

/**
 * Enable or disable auto-reconnect feature
 * @param enable true to enable auto-reconnect, false to disable
 */
void connection_manager_set_auto_reconnect(bool enable);

/**
 * Request connection parameter update
 * Used to optimize power consumption during different operation modes
 * 
 * @param interval_min Minimum connection interval (units of 1.25ms)
 * @param interval_max Maximum connection interval (units of 1.25ms)
 * @param latency Connection latency (number of events)
 * @param timeout Supervision timeout (units of 10ms)
 * @return 0 on success, negative error code on failure
 */
int connection_manager_update_params(uint16_t interval_min, uint16_t interval_max,
                                     uint16_t latency, uint16_t timeout);

#endif // CONNECTION_MANAGER_H
```

## include/led_control.h
```c
#ifndef LED_CONTROL_H
#define LED_CONTROL_H

#include <stdbool.h>

enum led_id {
	LED_ID_HEARTBEAT,
	LED_ID_PAIRING,
	LED_ID_CONNECTION,  /* Connection status LED */
	LED_ID_DATA,        /* Data transmission LED */
	LED_ID_ERROR,       /* Error/low battery LED */
	LED_ID_COUNT        /* Keep this last */
};

enum led_pattern {
	LED_PATTERN_OFF,
	LED_PATTERN_ON,
	LED_PATTERN_HEARTBEAT,
	LED_PATTERN_ADVERTISING,
	LED_PATTERN_CONNECTED,      /* Solid on when connected */
	LED_PATTERN_DATA_ACTIVE,    /* Blink when data is being transmitted */
	LED_PATTERN_ERROR,          /* Fast blink for error indication */
	LED_PATTERN_SLOW_BLINK,     /* Slow blink for listening mode */
};

void led_control_init(void);
void led_set_state(enum led_id id, bool on);
void led_set_pattern(enum led_id id, enum led_pattern pattern);
void led_control_update(void);

#endif // LED_CONTROL_H
```

## src/battery_monitor.c
```c
/**
 * Mipe Device Battery Monitor Implementation
 * 
 * Critical for achieving 30+ day battery life target
 * Monitors battery voltage and reports status to Host
 */

#include "battery_monitor.h"
#include "led_control.h"
#include <zephyr/kernel.h>
#include <zephyr/device.h>
#include <zephyr/drivers/adc.h>
#include <zephyr/logging/log.h>
#include <stdlib.h>

LOG_MODULE_REGISTER(battery_monitor, LOG_LEVEL_INF);

/* Battery voltage thresholds (in millivolts) */
#define BATTERY_VOLTAGE_MAX_MV     3300  /* 3.3V - Full battery */
#define BATTERY_VOLTAGE_MIN_MV     2200  /* 2.2V - Empty battery */
#define BATTERY_VOLTAGE_LOW_MV     2500  /* 2.5V - Low battery warning */
#define BATTERY_VOLTAGE_CRITICAL_MV 2300  /* 2.3V - Critical battery */

/* ADC configuration for battery measurement */
#define ADC_NODE           DT_NODELABEL(adc)
#define ADC_RESOLUTION     12
#define ADC_GAIN           ADC_GAIN_1_4
#define ADC_REFERENCE      ADC_REF_INTERNAL
#define ADC_ACQUISITION_TIME ADC_ACQ_TIME(ADC_ACQ_TIME_MICROSECONDS, 40)
#define ADC_CHANNEL_ID     0

/* Battery monitoring state */
static uint8_t current_battery_level = 100;
static uint16_t current_voltage_mv = BATTERY_VOLTAGE_MAX_MV;
static bool low_battery_warning_sent = false;
static bool critical_battery_warning_sent = false;
static bool adc_initialized = false;  /* Track if ADC has been initialized */

/* ADC device and configuration */
static const struct device *adc_dev = DEVICE_DT_GET(DT_NODELABEL(adc));
static struct adc_channel_cfg channel_cfg = {
    .gain = ADC_GAIN,
    .reference = ADC_REFERENCE,
    .acquisition_time = ADC_ACQUISITION_TIME,
    .channel_id = ADC_CHANNEL_ID,
    .input_positive = 2,  /* AIN2 - P0.04 pin */
};

static struct adc_sequence sequence = {
    .channels = BIT(ADC_CHANNEL_ID),
    .buffer = NULL,
    .buffer_size = 0,
    .resolution = ADC_RESOLUTION,
};

/* Forward declarations */
static uint16_t read_battery_voltage(void);
static uint8_t voltage_to_percentage(uint16_t voltage_mv);

/**
 * Initialize battery monitoring
 * Sets up ADC at boot for battery voltage in advertising
 */
void battery_monitor_init(void)
{
    int err;
    
    LOG_INF("========================================");
    LOG_INF("BATTERY MONITOR INITIALIZATION");
    LOG_INF("========================================");
    
    /* Get ADC device */
    if (!device_is_ready(adc_dev)) {
        /* If ADC is not available, use simulated battery */
        LOG_WRN("ADC device not ready, using simulated battery level");
        LOG_WRN("Check device tree configuration for ADC");
        current_battery_level = 85; /* Simulate 85% battery */
        return;
    }
    
    LOG_INF("ADC device is ready for battery monitoring");
    
    /* Configure ADC channel */
    LOG_INF("Configuring ADC channel %d", ADC_CHANNEL_ID);
    LOG_INF("  - Gain: 1/4");
    LOG_INF("  - Reference: Internal (0.6V)");
    LOG_INF("  - Resolution: %d bits", ADC_RESOLUTION);
    LOG_INF("  - Input: AIN2 (P0.04)");
    
    err = adc_channel_setup(adc_dev, &channel_cfg);
    if (err < 0) {
        LOG_ERR("ADC channel setup failed with error code: %d", err);
        LOG_ERR("Falling back to simulated battery level");
        current_battery_level = 85; /* Fallback to simulated */
        return;
    }
    
    LOG_INF("ADC channel configured successfully");
    
    /* Take initial battery reading */
    LOG_INF("Taking initial battery voltage reading...");
    current_voltage_mv = read_battery_voltage();
    current_battery_level = voltage_to_percentage(current_voltage_mv);
    
    LOG_INF("========================================");
    LOG_INF("BATTERY MONITOR INITIALIZED");
    LOG_INF("  Initial voltage: %u mV", current_voltage_mv);
    LOG_INF("  Battery level: %u%%", current_battery_level);
    LOG_INF("  Battery data will be included in advertising");
    LOG_INF("========================================");
    
    adc_initialized = true;
}

/**
 * Read battery voltage once (on-demand)
 * Used for SW3 button press and advertising updates
 */
void battery_monitor_read_once(void)
{
    if (!adc_initialized) {
        LOG_WRN("ADC not initialized, cannot read battery");
        return;
    }
    
    LOG_INF("========================================");
    LOG_INF("BATTERY READ REQUESTED");
    LOG_INF("========================================");
    
    /* Read current battery voltage */
    uint16_t voltage_mv = read_battery_voltage();
    uint8_t new_level = voltage_to_percentage(voltage_mv);
    
    LOG_INF("Battery Status:");
    LOG_INF("  Voltage: %u mV", voltage_mv);
    LOG_INF("  Level: %u%%", new_level);
    LOG_INF("  Status: %s", 
            voltage_mv <= BATTERY_VOLTAGE_CRITICAL_MV ? "CRITICAL" :
            voltage_mv <= BATTERY_VOLTAGE_LOW_MV ? "LOW" :
            "NORMAL");
    
    /* Check if battery level changed significantly (>5%) */
    int level_change = (int)new_level - (int)current_battery_level;
    if (abs(level_change) > 5) {
        LOG_INF("  Change from last read: %+d%%", level_change);
    }
    
    /* Always update the values when read on-demand */
    current_battery_level = new_level;
    current_voltage_mv = voltage_mv;
    
    /* Notify BLE service of battery reading */
    extern int ble_service_notify_battery(void);
    ble_service_notify_battery();
    
    /* Check for low battery conditions */
    if (voltage_mv <= BATTERY_VOLTAGE_CRITICAL_MV) {
        if (!critical_battery_warning_sent) {
            LOG_ERR("!!!!!!!!!!!!!!!!!!!!!!!!!!!!!!!!!!!!!!");
            LOG_ERR("CRITICAL BATTERY WARNING");
            LOG_ERR("  Voltage: %u mV", voltage_mv);
            LOG_ERR("  Level: %u%%", new_level);
            LOG_ERR("  Action: Consider charging immediately");
            LOG_ERR("!!!!!!!!!!!!!!!!!!!!!!!!!!!!!!!!!!!!!!");
            
            /* Power optimization: Don't use LED patterns to save battery */
            /* led_set_pattern(LED_ID_ERROR, LED_PATTERN_ERROR); */
            critical_battery_warning_sent = true;
            
            /* Force deep sleep to preserve remaining battery */
            if (new_level < 5) {
                LOG_ERR("Battery critically low - entering deep sleep");
                /* TMT6 will implement deep sleep mode */
            }
        }
    } else if (voltage_mv <= BATTERY_VOLTAGE_LOW_MV) {
        if (!low_battery_warning_sent) {
            LOG_WRN("========================================");
            LOG_WRN("LOW BATTERY WARNING");
            LOG_WRN("  Voltage: %u mV", voltage_mv);
            LOG_WRN("  Level: %u%%", new_level);
            LOG_WRN("========================================");
            
            /* Power optimization: Don't use LED patterns to save battery */
            /* led_set_pattern(LED_ID_ERROR, LED_PATTERN_SLOW_BLINK); */
            low_battery_warning_sent = true;
        }
    } else {
        /* Battery recovered above warning thresholds */
        if (low_battery_warning_sent || critical_battery_warning_sent) {
            LOG_INF("========================================");
            LOG_INF("BATTERY LEVEL RECOVERED");
            LOG_INF("  Voltage: %u mV", voltage_mv);
            LOG_INF("  Level: %u%%", new_level);
            LOG_INF("  Status: Normal operation");
            LOG_INF("========================================");
            
            /* Power optimization: LED already off */
            /* led_set_pattern(LED_ID_ERROR, LED_PATTERN_OFF); */
            low_battery_warning_sent = false;
            critical_battery_warning_sent = false;
        }
    }
    
    LOG_INF("========================================");
}

/**
 * Update battery monitoring (DEPRECATED)
 * This function is kept for compatibility but does nothing for power optimization
 */
void battery_monitor_update(void)
{
    /* Power optimization: This function is now a no-op */
    /* Battery is only read on-demand via battery_monitor_read_once() */
}

/**
 * Get current battery level as percentage
 * @return Battery level 0-100%
 */
uint8_t battery_monitor_get_level(void)
{
    /* For TMT3, return simulated battery level if ADC not available */
    if (!adc_dev || !device_is_ready(adc_dev)) {
        /* Simulate gradual battery drain for testing */
        static uint32_t sim_counter = 0;
        static bool logged_once = false;
        sim_counter++;
        
        if (!logged_once) {
            LOG_WRN("Using simulated battery level (ADC not available)");
            logged_once = true;
        }
        
        /* Decrease by 1% every 100 calls (simulating discharge) */
        uint8_t simulated = 95 - (sim_counter / 100);
        if (simulated < 10) simulated = 10; /* Don't go below 10% in simulation */
        return simulated;
    }
    
    return current_battery_level;
}

/**
 * Get current battery voltage in millivolts
 * @return Battery voltage in mV
 */
uint16_t battery_monitor_get_voltage_mv(void)
{
    /* Update battery reading for advertising */
    if (adc_initialized) {
        current_voltage_mv = read_battery_voltage();
        current_battery_level = voltage_to_percentage(current_voltage_mv);
    }
    return current_voltage_mv;
}

/**
 * Check if battery is low
 * @return true if battery is below low threshold
 */
bool battery_monitor_is_low(void)
{
    return (current_voltage_mv <= BATTERY_VOLTAGE_LOW_MV);
}

/**
 * Check if battery is critical
 * @return true if battery is critically low
 */
bool battery_monitor_is_critical(void)
{
    return (current_voltage_mv <= BATTERY_VOLTAGE_CRITICAL_MV);
}

/* Internal functions */

/**
 * Read battery voltage from ADC
 * @return Voltage in millivolts
 */
static uint16_t read_battery_voltage(void)
{
    if (!adc_initialized || !adc_dev || !device_is_ready(adc_dev)) {
        /* Return simulated voltage if ADC not available */
        static bool logged_once = false;
        if (!logged_once) {
            LOG_WRN("ADC not available - returning simulated voltage");
            logged_once = true;
        }
        return BATTERY_VOLTAGE_MAX_MV - 200; /* Simulate 2.8V */
    }
    
    LOG_DBG("Reading ADC channel %d for battery voltage", ADC_CHANNEL_ID);
    
    int16_t buf;
    sequence.buffer = &buf;
    sequence.buffer_size = sizeof(buf);
    
    int err = adc_read(adc_dev, &sequence);
    if (err < 0) {
        LOG_ERR("ADC read failed with error code: %d", err);
        LOG_ERR("Returning last known voltage: %u mV", current_voltage_mv);
        return current_voltage_mv; /* Return last known value */
    }
    
    LOG_DBG("ADC raw value: %d", buf);
    
    /* Convert ADC value to millivolts */
    /* This calculation depends on your hardware design */
    /* Adjust based on voltage divider and reference voltage */
    int32_t val_mv = buf;
    adc_raw_to_millivolts(adc_ref_internal(adc_dev), 
                         ADC_GAIN, 
                         ADC_RESOLUTION, 
                         &val_mv);
    
    LOG_DBG("ADC converted to: %d mV (before divider correction)", val_mv);
    
    /* Apply voltage divider correction if needed */
    /* For 3.3V system - adjust this multiplier based on your actual voltage divider */
    /* If no voltage divider, comment out the multiplication */
    /* val_mv *= 2; */  /* Uncomment and adjust if using voltage divider */
    
    LOG_DBG("Final battery voltage: %d mV (direct measurement, no divider)", val_mv);
    
    return (uint16_t)val_mv;
}

/**
 * Convert battery voltage to percentage
 * @param voltage_mv Voltage in millivolts
 * @return Battery percentage 0-100%
 */
static uint8_t voltage_to_percentage(uint16_t voltage_mv)
{
    if (voltage_mv >= BATTERY_VOLTAGE_MAX_MV) {
        return 100;
    }
    if (voltage_mv <= BATTERY_VOLTAGE_MIN_MV) {
        return 0;
    }
    
    /* Linear interpolation between min and max */
    uint32_t range = BATTERY_VOLTAGE_MAX_MV - BATTERY_VOLTAGE_MIN_MV;
    uint32_t offset = voltage_mv - BATTERY_VOLTAGE_MIN_MV;
    uint8_t percentage = (uint8_t)((offset * 100) / range);
    
    return percentage;
}
```

## src/ble_service.c
```c
/**
 * MIPE Device BLE Service - Simplified from Host code
 * Based on proven working Host BLE peripheral implementation
 */

#include <zephyr/kernel.h>
#include <zephyr/logging/log.h>
#include <zephyr/bluetooth/bluetooth.h>
#include <zephyr/bluetooth/hci.h>
#include <zephyr/bluetooth/conn.h>
#include <zephyr/bluetooth/uuid.h>
#include <zephyr/bluetooth/gatt.h>
#include <zephyr/sys/byteorder.h>

#include "ble_service.h"
#include "led_control.h"
#include "battery_monitor.h"

LOG_MODULE_REGISTER(ble_service, LOG_LEVEL_INF);

/* MIPE Service UUID: 87654321-4321-8765-4321-987654321098 */
#define MIPE_SERVICE_UUID BT_UUID_DECLARE_128( \
    BT_UUID_128_ENCODE(0x87654321, 0x4321, 0x8765, 0x4321, 0x987654321098))

/* Battery Characteristic UUID: 87654323-4321-8765-4321-987654321098 */
#define BATTERY_CHAR_UUID BT_UUID_DECLARE_128( \
    BT_UUID_128_ENCODE(0x87654323, 0x4321, 0x8765, 0x4321, 0x987654321098))

/* Connection state */
static struct bt_conn *current_conn = NULL;
static bool battery_notify_enabled = false;

/* Data buffers */
static uint8_t battery_level = 100;   /* Battery percentage */

/* Forward declarations */
static void connected(struct bt_conn *conn, uint8_t err);
static void disconnected(struct bt_conn *conn, uint8_t reason);
static ssize_t read_battery(struct bt_conn *conn, const struct bt_gatt_attr *attr,
                            void *buf, uint16_t len, uint16_t offset);
static void battery_ccc_changed(const struct bt_gatt_attr *attr, uint16_t value);

/* Connection callbacks */
BT_CONN_CB_DEFINE(conn_callbacks) = {
    .connected = connected,
    .disconnected = disconnected,
};

/* MIPE Service Definition - following Host pattern */
BT_GATT_SERVICE_DEFINE(mipe_service,
    BT_GATT_PRIMARY_SERVICE(MIPE_SERVICE_UUID),
    
    /* Battery Characteristic - Read & Notify */
    BT_GATT_CHARACTERISTIC(BATTERY_CHAR_UUID,
                          BT_GATT_CHRC_READ | BT_GATT_CHRC_NOTIFY,
                          BT_GATT_PERM_READ,
                          read_battery, NULL, &battery_level),
    BT_GATT_CCC(battery_ccc_changed,
               BT_GATT_PERM_READ | BT_GATT_PERM_WRITE),
);

/* Advertising data - will be updated dynamically with battery voltage */
static struct bt_data ad[3] = {
    BT_DATA_BYTES(BT_DATA_FLAGS, (BT_LE_AD_GENERAL | BT_LE_AD_NO_BREDR)),
    BT_DATA_BYTES(BT_DATA_UUID128_ALL,
                  BT_UUID_128_ENCODE(0x87654321, 0x4321, 0x8765, 0x4321, 0x987654321098)),
    /* Third element will be manufacturer data with battery voltage */
};

/* Buffer for manufacturer data (company ID + battery voltage) */
static uint8_t mfg_data[4] = {
    0xFF, 0xFF,  /* Company ID (0xFFFF for testing) */
    0x00, 0x00   /* Battery voltage in mV (will be updated) */
};

/* Scan response data with device name */
static const struct bt_data sd[] = {
    BT_DATA(BT_DATA_NAME_COMPLETE, "SinglePing Mipe", 15),
};

/* Advertising parameters - slowed down to 500ms for power saving */
static struct bt_le_adv_param adv_param = BT_LE_ADV_PARAM_INIT(
    BT_LE_ADV_OPT_CONN,
    BT_GAP_ADV_SLOW_INT_MIN,  /* 1000ms */
    BT_GAP_ADV_SLOW_INT_MAX,  /* 1250ms */
    NULL);

/* Helper function to update advertising data with battery voltage */
static void update_advertising_data(void)
{
    uint16_t battery_mv = battery_monitor_get_voltage_mv();
    
    /* Update manufacturer data with battery voltage */
    mfg_data[2] = battery_mv & 0xFF;           /* Low byte */
    mfg_data[3] = (battery_mv >> 8) & 0xFF;    /* High byte */
    
    /* Update the advertising data array */
    ad[2] = (struct bt_data)BT_DATA(BT_DATA_MANUFACTURER_DATA, mfg_data, sizeof(mfg_data));
    
    /* Enhanced debug logging */
    LOG_INF("Battery in advertising: %u mV (0x%02X 0x%02X 0x%02X 0x%02X)", 
            battery_mv, mfg_data[0], mfg_data[1], mfg_data[2], mfg_data[3]);
}

void ble_service_init(void)
{
    int err;

    LOG_INF("Initializing MIPE BLE Service");

    /* Initialize Bluetooth */
    err = bt_enable(NULL);
    if (err) {
        LOG_ERR("Bluetooth init failed (err %d)", err);
        led_set_pattern(LED_ID_ERROR, LED_PATTERN_ERROR);
        return;
    }

    LOG_INF("Bluetooth initialized");

    /* Set TX power to maximum (+8 dBm) for better RSSI readings */
    #if defined(CONFIG_BT_CTLR_TX_PWR_PLUS_8)
        LOG_INF("TX Power set to maximum (+8 dBm) for optimal RSSI measurements");
    #else
        LOG_WRN("Maximum TX power not configured - using default");
    #endif

    /* Update advertising data with current battery voltage */
    update_advertising_data();

    /* Start advertising - using Host's proven method */
    err = bt_le_adv_start(&adv_param,
                         ad, ARRAY_SIZE(ad),
                         sd, ARRAY_SIZE(sd));
    if (err) {
        LOG_ERR("Advertising failed to start (err %d)", err);
        led_set_pattern(LED_ID_ERROR, LED_PATTERN_ERROR);
        return;
    }

    LOG_INF("Advertising started - Device name: SinglePing Mipe");
    LOG_INF("Battery voltage in advertising: %u mV", battery_monitor_get_voltage_mv());
    /* Fix: Use LED1 for advertising, not LED3 */
    led_set_pattern(LED_ID_PAIRING, LED_PATTERN_ADVERTISING);
}

static void connected(struct bt_conn *conn, uint8_t err)
{
    char addr[BT_ADDR_LE_STR_LEN];

    bt_addr_le_to_str(bt_conn_get_dst(conn), addr, sizeof(addr));

    if (err) {
        LOG_ERR("Failed to connect to %s (err %d)", addr, err);
        return;
    }

    LOG_INF("Connected to Host: %s", addr);
    
    current_conn = bt_conn_ref(conn);
    
    /* Update LEDs for connected state - Use LED1 for connection */
    led_set_pattern(LED_ID_PAIRING, LED_PATTERN_CONNECTED);    /* LED1 solid when connected */
    led_set_pattern(LED_ID_CONNECTION, LED_PATTERN_OFF);       /* LED2 off */
}

static void disconnected(struct bt_conn *conn, uint8_t reason)
{
    char addr[BT_ADDR_LE_STR_LEN];

    bt_addr_le_to_str(bt_conn_get_dst(conn), addr, sizeof(addr));
    LOG_INF("Disconnected: %s (reason 0x%02x)", addr, reason);

    if (current_conn) {
        bt_conn_unref(current_conn);
        current_conn = NULL;
    }

    battery_notify_enabled = false;

    /* Update LEDs for disconnected state */
    led_set_pattern(LED_ID_PAIRING, LED_PATTERN_OFF);     /* LED1 off */
    led_set_pattern(LED_ID_CONNECTION, LED_PATTERN_OFF);  /* LED2 off */
    led_set_pattern(LED_ID_DATA, LED_PATTERN_OFF);        /* LED3 off */

    /* Stop advertising first */
    bt_le_adv_stop();
    
    /* Small delay for clean transition */
    k_msleep(100);

    /* Update advertising data with current battery voltage */
    update_advertising_data();

    /* Restart advertising */
    int err = bt_le_adv_start(&adv_param,
                              ad, ARRAY_SIZE(ad),
                              sd, ARRAY_SIZE(sd));
    if (err) {
        LOG_ERR("Failed to restart advertising (err %d)", err);
        led_set_pattern(LED_ID_ERROR, LED_PATTERN_ERROR);
    } else {
        LOG_INF("Advertising restarted with battery: %u mV", battery_monitor_get_voltage_mv());
        led_set_pattern(LED_ID_PAIRING, LED_PATTERN_ADVERTISING);
    }
}

static ssize_t read_battery(struct bt_conn *conn, const struct bt_gatt_attr *attr,
                            void *buf, uint16_t len, uint16_t offset)
{
    battery_level = battery_monitor_get_level();
    
    LOG_DBG("Battery read: %u%%", battery_level);
    
    return bt_gatt_attr_read(conn, attr, buf, len, offset,
                            &battery_level, sizeof(battery_level));
}

static void battery_ccc_changed(const struct bt_gatt_attr *attr, uint16_t value)
{
    battery_notify_enabled = (value == BT_GATT_CCC_NOTIFY);
    
    LOG_INF("Battery notifications %s", battery_notify_enabled ? "enabled" : "disabled");
}

/* Power-optimized listening mode after disconnection */
void ble_service_start_listening_mode(void)
{
    /* For now, just use normal advertising - can optimize later */
    LOG_INF("Entering listening mode");
    led_set_pattern(LED_ID_PAIRING, LED_PATTERN_SLOW_BLINK);
}

/* Send battery notification */
int ble_service_notify_battery(void)
{
    if (!current_conn || !battery_notify_enabled) {
        return -ENOTCONN;
    }
    
    battery_level = battery_monitor_get_level();
    
    int err = bt_gatt_notify(current_conn, &mipe_service.attrs[2], 
                            &battery_level, sizeof(battery_level));
    if (err) {
        LOG_ERR("Failed to send battery notification (err %d)", err);
    }
    
    return err;
}

/* Update function called from main loop */
void ble_service_update(void)
{
    static uint32_t last_battery_update = 0;
    static uint32_t last_adv_update = 0;
    uint32_t now = k_uptime_get_32();
    
    /* Update battery notifications every 60 seconds when connected */
    if (current_conn && (now - last_battery_update) > 60000) {
        ble_service_notify_battery();
        last_battery_update = now;
    }
    
    /* Update advertising data with battery every 30 seconds when not connected */
    if (!current_conn && (now - last_adv_update) > 30000) {
        /* Stop advertising */
        bt_le_adv_stop();
        
        /* Update with fresh battery data */
        update_advertising_data();
        
        /* Restart advertising with updated data */
        int err = bt_le_adv_start(&adv_param,
                                  ad, ARRAY_SIZE(ad),
                                  sd, ARRAY_SIZE(sd));
        if (err) {
            LOG_ERR("Failed to update advertising (err %d)", err);
        } else {
            LOG_DBG("Advertising updated with battery: %u mV", battery_monitor_get_voltage_mv());
        }
        
        last_adv_update = now;
    }
}

/* Check connection status */
bool ble_service_is_connected(void)
{
    return (current_conn != NULL);
}
```

## src/button_control.c
```c
#include "button_control.h"
#include <zephyr/kernel.h>
#include <zephyr/drivers/gpio.h>
#include <zephyr/sys/printk.h>

// Define the GPIO pins connected to the buttons from the device tree
#define BUTTON0_NODE DT_ALIAS(sw0)
#define BUTTON3_NODE DT_ALIAS(sw3)

static const struct gpio_dt_spec button0 = GPIO_DT_SPEC_GET(BUTTON0_NODE, gpios);
static const struct gpio_dt_spec button3 = GPIO_DT_SPEC_GET(BUTTON3_NODE, gpios);

// Debouncing state variables for SW0
#define DEBOUNCE_DELAY_MS 50

static bool debounced_state = false;
static bool last_raw_state = false;
static int64_t last_change_time = 0;
static bool press_event_detected = false;

// Debouncing state variables for SW3 (battery button)
static bool sw3_debounced_state = false;
static bool sw3_last_raw_state = false;
static int64_t sw3_last_change_time = 0;
static bool sw3_press_event_detected = false;

// Initialize button control system
void button_control_init(void) {
    int ret;

    // Initialize SW0
    if (!gpio_is_ready_dt(&button0)) {
        printk("Error: button0 device %s is not ready\n", button0.port->name);
        return;
    }

    ret = gpio_pin_configure_dt(&button0, GPIO_INPUT);
    if (ret < 0) {
        printk("Error %d: failed to configure button0 device %s pin %d\n",
               ret, button0.port->name, button0.pin);
        return;
    }

    // Initialize SW0 state
    bool initial_reading = gpio_pin_get_dt(&button0) > 0;
    debounced_state = initial_reading;
    last_raw_state = initial_reading;
    last_change_time = k_uptime_get();

    // Initialize SW3
    if (!gpio_is_ready_dt(&button3)) {
        printk("Error: button3 device %s is not ready\n", button3.port->name);
        return;
    }

    ret = gpio_pin_configure_dt(&button3, GPIO_INPUT);
    if (ret < 0) {
        printk("Error %d: failed to configure button3 device %s pin %d\n",
               ret, button3.port->name, button3.pin);
        return;
    }

    // Initialize SW3 state
    bool sw3_initial = gpio_pin_get_dt(&button3) > 0;
    sw3_debounced_state = sw3_initial;
    sw3_last_raw_state = sw3_initial;
    sw3_last_change_time = k_uptime_get();
    
    printk("Button control initialized: SW0 and SW3 ready for power-optimized operation\n");
}

// Update button state machine, to be called from the main loop
void button_control_update(void) {
    int64_t now = k_uptime_get();
    
    // Update SW0
    bool current_raw_state = gpio_pin_get_dt(&button0) > 0;

    // Reset the event flag. It's only true for one call to update().
    press_event_detected = false;

    // If the raw state has changed, reset the timer
    if (current_raw_state != last_raw_state) {
        last_change_time = now;
    }

    // After the debounce delay, if the state is stable, update the debounced state
    if ((now - last_change_time) > DEBOUNCE_DELAY_MS) {
        // If the debounced state is changing from released to pressed
        if (current_raw_state == true && debounced_state == false) {
            press_event_detected = true;
        }
        debounced_state = current_raw_state;
    }

    last_raw_state = current_raw_state;
    
    // Update SW3 (battery button)
    bool sw3_current = gpio_pin_get_dt(&button3) > 0;
    
    // Reset SW3 event flag
    sw3_press_event_detected = false;
    
    // If the raw state has changed, reset the timer
    if (sw3_current != sw3_last_raw_state) {
        sw3_last_change_time = now;
    }
    
    // After the debounce delay, if the state is stable, update the debounced state
    if ((now - sw3_last_change_time) > DEBOUNCE_DELAY_MS) {
        // If the debounced state is changing from released to pressed
        if (sw3_current == true && sw3_debounced_state == false) {
            sw3_press_event_detected = true;
            printk("SW3 pressed - Battery read requested\n");
        }
        sw3_debounced_state = sw3_current;
    }
    
    sw3_last_raw_state = sw3_current;
}

// Returns true for one cycle if a debounced press event was detected on SW0
bool button_was_pressed(void) {
    return press_event_detected;
}

// Returns true for one cycle if SW3 (battery button) was pressed
bool button_sw3_was_pressed(void) {
    return sw3_press_event_detected;
}
```

## src/connection_manager.c
```c
/**
 * Mipe Device Connection Manager - P003 Implementation
 * 
 * Handles BLE connection state management for Mipe device
 * Implements power-optimized connection handling from Host
 * 
 * Connection States:
 * - IDLE: No connection, power-optimized advertising
 * - ADVERTISING: Active advertising for Host discovery
 * - CONNECTED: Active connection with Host device
 * - LISTENING: Post-disconnection recovery mode
 */

#include "connection_manager.h"
#include "led_control.h"
#include <zephyr/kernel.h>
#include <zephyr/logging/log.h>
#include <zephyr/bluetooth/bluetooth.h>
#include <zephyr/bluetooth/conn.h>
#include <zephyr/bluetooth/gatt.h>

LOG_MODULE_REGISTER(connection_manager, LOG_LEVEL_INF);

/* Connection state machine */
typedef enum {
    CONN_STATE_IDLE,
    CONN_STATE_ADVERTISING,
    CONN_STATE_CONNECTED,
    CONN_STATE_LISTENING,
} conn_state_t;

/* Connection manager context */
static struct {
    conn_state_t state;
    struct bt_conn *conn;
    uint32_t disconnect_time;
    bool auto_reconnect;
    uint8_t reconnect_attempts;
} conn_ctx = {
    .state = CONN_STATE_IDLE,
    .conn = NULL,
    .disconnect_time = 0,
    .auto_reconnect = true,
    .reconnect_attempts = 0,
};

/* Connection parameters optimized for power */
static struct bt_le_conn_param conn_params = {
    .interval_min = BT_GAP_INIT_CONN_INT_MIN,  /* 30ms min */
    .interval_max = BT_GAP_INIT_CONN_INT_MAX,  /* 50ms max */
    .latency = 4,                              /* Allow 4 connection events to be skipped */
    .timeout = 400,                             /* 4 seconds supervision timeout */
};

/* Forward declarations */
static void update_connection_state(conn_state_t new_state);
static void handle_listening_mode(void);

/**
 * Connection established callback
 * Called when Host successfully connects to Mipe
 */
static void connected(struct bt_conn *conn, uint8_t err)
{
    char addr[BT_ADDR_LE_STR_LEN];
    
    bt_addr_le_to_str(bt_conn_get_dst(conn), addr, sizeof(addr));
    
    if (err) {
        LOG_ERR("Connection failed to %s (err 0x%02x)", addr, err);
        update_connection_state(CONN_STATE_ADVERTISING);
        return;
    }
    
    LOG_INF("Connected to Host: %s", addr);
    
    /* Store connection reference */
    if (conn_ctx.conn) {
        bt_conn_unref(conn_ctx.conn);
    }
    conn_ctx.conn = bt_conn_ref(conn);
    conn_ctx.reconnect_attempts = 0;
    
    /* Update connection parameters for power optimization */
    int ret = bt_conn_le_param_update(conn, &conn_params);
    if (ret) {
        LOG_WRN("Failed to request connection parameter update (err %d)", ret);
    } else {
        LOG_INF("Connection parameters update requested");
    }
    
    /* Update state */
    update_connection_state(CONN_STATE_CONNECTED);
}

/**
 * Connection lost callback
 * Triggers listening mode for reconnection
 */
static void disconnected(struct bt_conn *conn, uint8_t reason)
{
    char addr[BT_ADDR_LE_STR_LEN];
    
    bt_addr_le_to_str(bt_conn_get_dst(conn), addr, sizeof(addr));
    LOG_INF("Disconnected from %s (reason 0x%02x)", addr, reason);
    
    /* Clean up connection reference */
    if (conn_ctx.conn) {
        bt_conn_unref(conn_ctx.conn);
        conn_ctx.conn = NULL;
    }
    
    /* Record disconnect time for timeout handling */
    conn_ctx.disconnect_time = k_uptime_get();
    
    /* Enter listening mode for reconnection */
    if (conn_ctx.auto_reconnect) {
        LOG_INF("Entering listening mode for reconnection");
        update_connection_state(CONN_STATE_LISTENING);
    } else {
        update_connection_state(CONN_STATE_IDLE);
    }
}

/**
 * Connection parameter update callback
 * Logs parameter changes for monitoring
 */
static void conn_param_updated(struct bt_conn *conn, uint16_t interval,
                               uint16_t latency, uint16_t timeout)
{
    LOG_INF("Connection parameters updated: interval=%d, latency=%d, timeout=%d",
            interval, latency, timeout);
}

/**
 * Connection parameter update request callback
 * Accepts Host's parameter update requests
 */
static bool conn_param_req(struct bt_conn *conn, struct bt_le_conn_param *param)
{
    LOG_INF("Connection parameter update requested by Host");
    LOG_INF("Requested: interval=[%d,%d], latency=%d, timeout=%d",
            param->interval_min, param->interval_max,
            param->latency, param->timeout);
    
    /* Accept Host's parameters for optimal coordination */
    return true;
}

/* Connection callbacks structure */
static struct bt_conn_cb conn_callbacks = {
    .connected = connected,
    .disconnected = disconnected,
    .le_param_updated = conn_param_updated,
    .le_param_req = conn_param_req,
};

/**
 * Update connection state machine
 */
static void update_connection_state(conn_state_t new_state)
{
    if (conn_ctx.state == new_state) {
        return;
    }
    
    LOG_INF("Connection state: %d -> %d", conn_ctx.state, new_state);
    conn_ctx.state = new_state;
    
    switch (new_state) {
    case CONN_STATE_IDLE:
        /* Stop any advertising */
        bt_le_adv_stop();
        break;
        
    case CONN_STATE_ADVERTISING:
        /* Handled by ble_service */
        break;
        
    case CONN_STATE_CONNECTED:
        /* Connection established */
        break;
        
    case CONN_STATE_LISTENING:
        /* Start low-power advertising for reconnection */
        handle_listening_mode();
        break;
    }
}

/**
 * Handle listening mode for power-optimized reconnection
 */
static void handle_listening_mode(void)
{
    /* Advertising parameters for listening mode - slower for power saving */
    static const struct bt_le_adv_param listening_adv_param = {
        .id = BT_ID_DEFAULT,
        .sid = 0,
        .secondary_max_skip = 0,
        .options = BT_LE_ADV_OPT_CONN | BT_LE_ADV_OPT_USE_NAME,
        .interval_min = BT_GAP_ADV_SLOW_INT_MIN,  /* 1000ms min */
        .interval_max = BT_GAP_ADV_SLOW_INT_MAX,  /* 1200ms max */
        .peer = NULL,
    };
    
    /* Create advertising data */
    const struct bt_data ad[] = {
        BT_DATA_BYTES(BT_DATA_FLAGS, (BT_LE_AD_GENERAL | BT_LE_AD_NO_BREDR)),
    };
    
    int err = bt_le_adv_start(&listening_adv_param, ad, ARRAY_SIZE(ad), NULL, 0);
    if (err) {
        LOG_ERR("Failed to start listening mode advertising (err %d)", err);
        update_connection_state(CONN_STATE_IDLE);
    } else {
        LOG_INF("Listening mode advertising started (low power)");
        conn_ctx.reconnect_attempts++;
    }
}

/**
 * Initialize connection manager
 */
void connection_manager_init(void)
{
    LOG_INF("Initializing connection manager for P003");
    
    /* Register connection callbacks */
    bt_conn_cb_register(&conn_callbacks);
    
    /* Set initial state */
    conn_ctx.state = CONN_STATE_ADVERTISING;
    conn_ctx.auto_reconnect = true;
    
    LOG_INF("Connection manager initialized - ready for Host connections");
}

/**
 * Update connection manager
 * Handles timeouts and state transitions
 */
void connection_manager_update(void)
{
    static uint32_t last_check = 0;
    uint32_t now = k_uptime_get();
    
    /* Check every second */
    if (now - last_check < 1000) {
        return;
    }
    last_check = now;
    
    switch (conn_ctx.state) {
    case CONN_STATE_LISTENING:
        /* Check for listening mode timeout (5 minutes) */
        if (now - conn_ctx.disconnect_time > (5 * 60 * 1000)) {
            LOG_INF("Listening mode timeout - entering idle state");
            update_connection_state(CONN_STATE_IDLE);
        }
        break;
        
    case CONN_STATE_IDLE:
        /* In idle state, check if we should restart advertising */
        if (conn_ctx.auto_reconnect && conn_ctx.reconnect_attempts < 3) {
            LOG_INF("Retrying advertising (attempt %d/3)", conn_ctx.reconnect_attempts + 1);
            update_connection_state(CONN_STATE_ADVERTISING);
        }
        break;
        
    default:
        break;
    }
}

/**
 * Get current connection state
 */
bool connection_manager_is_connected(void)
{
    return (conn_ctx.state == CONN_STATE_CONNECTED) && (conn_ctx.conn != NULL);
}

/**
 * Enable/disable auto-reconnect feature
 */
void connection_manager_set_auto_reconnect(bool enable)
{
    conn_ctx.auto_reconnect = enable;
    LOG_INF("Auto-reconnect %s", enable ? "enabled" : "disabled");
}

/**
 * Request connection parameter update
 * Used to optimize power consumption during different operation modes
 */
int connection_manager_update_params(uint16_t interval_min, uint16_t interval_max,
                                     uint16_t latency, uint16_t timeout)
{
    if (!conn_ctx.conn) {
        return -ENOTCONN;
    }
    
    struct bt_le_conn_param params = {
        .interval_min = interval_min,
        .interval_max = interval_max,
        .latency = latency,
        .timeout = timeout,
    };
    
    int ret = bt_conn_le_param_update(conn_ctx.conn, &params);
    if (ret) {
        LOG_ERR("Failed to update connection parameters (err %d)", ret);
    } else {
        LOG_INF("Connection parameter update requested");
    }
    
    return ret;
}
```
