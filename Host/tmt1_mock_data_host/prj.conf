## CMakeLists.txt
```
cmake_minimum_required(VERSION 3.20.0)
find_package(Zephyr REQUIRED HINTS $ENV{ZEPHYR_BASE})
project(tmt1_mock_data_host)

# Include header directory
target_include_directories(app PRIVATE include)

# Add all source files
target_sources(app PRIVATE
    src/main.c
)
```

## prj.conf
```kconfig
# ========================================
# C LIBRARY CONFIGURATION (CRITICAL)
# ========================================
CONFIG_PICOLIBC=n
CONFIG_NEWLIB_LIBC=y
CONFIG_NEWLIB_LIBC_NANO=n

# ========================================
# SYSTEM CONFIGURATION
# ========================================
CONFIG_MAIN_STACK_SIZE=2048
CONFIG_SYSTEM_WORKQUEUE_STACK_SIZE=1024
CONFIG_IDLE_STACK_SIZE=320
CONFIG_ISR_STACK_SIZE=2048
CONFIG_HEAP_MEM_POOL_SIZE=2048

# ========================================
# GPIO AND HARDWARE SUPPORT
# ========================================
CONFIG_GPIO=y
CONFIG_PINCTRL=y

# ========================================
# UART AND CONSOLE (DEBUG OUTPUT)
# ========================================
CONFIG_SERIAL=y
CONFIG_UART_CONSOLE=y
CONFIG_CONSOLE=y
CONFIG_UART_LINE_CTRL=y

# ========================================
# LOGGING SYSTEM (RECOMMENDED)
# ========================================
CONFIG_LOG=y
CONFIG_LOG_DEFAULT_LEVEL=3
CONFIG_LOG_BACKEND_UART=y
CONFIG_LOG_BACKEND_SHOW_COLOR=n
CONFIG_LOG_BACKEND_FORMAT_TIMESTAMP=y

# ========================================
# TIMING AND KERNEL
# ========================================
CONFIG_SYS_CLOCK_TICKS_PER_SEC=1000
CONFIG_KERNEL_COHERENCE=y

# ========================================
# BLE CONFIGURATION (COMPLETE WORKING SET)
# ========================================
CONFIG_BT=y
CONFIG_BT_PERIPHERAL=y
CONFIG_BT_CENTRAL=n
CONFIG_BT_DEVICE_NAME="MIPE_HOST_TMT1"
CONFIG_BT_DEVICE_APPEARANCE=833
CONFIG_BT_MAX_CONN=1
CONFIG_BT_MAX_PAIRED=1

# BLE Stack Configuration
CONFIG_BT_HCI=y
CONFIG_BT_HCI_HOST=y
CONFIG_BT_HCI_VS_EXT=y
CONFIG_BT_ID_MAX=1
CONFIG_BT_ECC=y

# BLE Advertising
CONFIG_BT_BROADCASTER=y
CONFIG_BT_EXT_ADV=n
CONFIG_BT_OBSERVER=y

# BLE GATT
CONFIG_BT_GATT=y
CONFIG_BT_GATT_SERVICE_CHANGED=y
CONFIG_BT_GATT_CACHING=y
CONFIG_BT_GATT_ENFORCE_SUBSCRIPTION=n

# BLE Security
CONFIG_BT_SMP=y
CONFIG_BT_SIGNING=y
CONFIG_BT_SMP_SC_PAIR_ONLY=n
CONFIG_BT_SMP_ENFORCE_MITM=n
```

## src/main.c
```c
#include <zephyr/kernel.h>
#include <zephyr/drivers/gpio.h>
#include <zephyr/logging/log.h>

LOG_MODULE_REGISTER(main, LOG_LEVEL_INF);

#define LED0_NODE DT_ALIAS(led0)

static const struct gpio_dt_spec led0 = GPIO_DT_SPEC_GET(LED0_NODE, gpios);

int main(void)
{
    int ret;

    if (!gpio_is_ready_dt(&led0)) {
        LOG_ERR("LED0 device not ready");
        return 0;
    }

    ret = gpio_pin_configure_dt(&led0, GPIO_OUTPUT_ACTIVE);
    if (ret < 0) {
        LOG_ERR("Failed to configure LED0: %d", ret);
        return 0;
    }

    LOG_INF("Starting LED heartbeat on LED0");

    while (true) {
        gpio_pin_toggle_dt(&led0);
        k_msleep(500);
    }
    return 0;
}
```
